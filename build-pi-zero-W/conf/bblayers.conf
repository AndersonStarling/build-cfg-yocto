## build-pi-zero-W/conf/bblayers.conf
```bitbake
# POKY_BBLAYERS_CONF_VERSION is increased each time build/conf/bblayers.conf
# changes incompatibly
POKY_BBLAYERS_CONF_VERSION = "2"

BBPATH = "${TOPDIR}"
BBFILES ?= ""

BBLAYERS ?= " \
  /home/ntai/yocto/poky/meta \
  /home/ntai/yocto/poky/meta-poky \
  /home/ntai/yocto/poky/meta-yocto-bsp \
  /home/ntai/yocto/meta-openembedded/meta-oe \
  /home/ntai/yocto/meta-qt5 \
  /home/ntai/yocto/meta-raspberrypi \
  /home/ntai/yocto/meta-lcd \
  "
```
